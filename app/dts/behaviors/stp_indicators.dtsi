/ {
    behaviors {
        stp: behavior_stp_indicators {
            compatible = "zmk,behavior-stp-indicators";
            #binding-cells = <1>;
            display-name = "Battery Indication";
        };
    };
};
