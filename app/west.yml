## app/west.yml
```yaml
manifest:
  remotes:
    - name: zephyrproject-rtos
      url-base: https://github.com/zephyrproject-rtos
    - name: zmkfirmware
      url-base: https://github.com/zmkfirmware
  projects:
    - name: zephyr
      remote: zmkfirmware
      revision: v3.5.0+zmk-fixes
      clone-depth: 1
      import:
        name-blocklist:
          - ci-tools
          - hal_altera
          - hal_cypress
          - hal_infineon
          - hal_microchip
          - hal_nxp
          - hal_openisa
          - hal_silabs
          - hal_xtensa
          - hal_st
          - hal_ti
          - loramac-node
          - mcuboot
          - mcumgr
          - net-tools
          - openthread
          - edtt
          - trusted-firmware-m
    - name: nanopb
      revision: 65cbefb4695bc7af1cb733ced99618afb3586b20
      path: modules/lib/nanopb
      remote: zephyrproject-rtos
    - name: zmk-studio-messages
      revision: c0205a68e221c8f117da476d12942b8219241f7c
      path: modules/msgs/zmk-studio-messages
      remote: zmkfirmware
  self:
    west-commands: scripts/west-commands.yml
```
